## firmware/components/orb_model/Kconfig
```kconfig
menu "Orb model"

config ORB_MODEL_DEMO
    bool "Run the offline shell preview with synthetic sessions/cards"
    default n
    help
        Explicit developer fixture switch. The application labels this preview
        as Demo and does not start networking or connect to the live hub. Saved
        Wi-Fi and pairing data are preserved. Service actions are disabled.
        Leave this off for normal firmware, including paired devices.

endmenu
```

## firmware/components/orb_net/test_app/sdkconfig.defaults
```kconfig
# Board essentials, as in firmware/sdkconfig.defaults
CONFIG_IDF_TARGET="esp32s3"
CONFIG_COMPILER_OPTIMIZATION_PERF=y
CONFIG_FREERTOS_HZ=1000
CONFIG_ESPTOOLPY_FLASHMODE_QIO=y
CONFIG_ESPTOOLPY_FLASHFREQ_80M=y
CONFIG_ESPTOOLPY_FLASHSIZE_32MB=y
CONFIG_SPIRAM=y
CONFIG_SPIRAM_MODE_OCT=y
CONFIG_SPIRAM_SPEED_80M=y
CONFIG_SPIRAM_FETCH_INSTRUCTIONS=y
CONFIG_SPIRAM_RODATA=y
CONFIG_SPIRAM_XIP_FROM_PSRAM=y
CONFIG_ESP32S3_INSTRUCTION_CACHE_32KB=y
CONFIG_ESP32S3_DATA_CACHE_64KB=y
CONFIG_ESP32S3_DATA_CACHE_LINE_64B=y
CONFIG_ESP_DEFAULT_CPU_FREQ_MHZ_240=y
CONFIG_ESP_CONSOLE_USB_SERIAL_JTAG=y
CONFIG_PARTITION_TABLE_CUSTOM=y
CONFIG_PARTITION_TABLE_CUSTOM_FILENAME="../../../partitions.csv"
CONFIG_BOOTLOADER_APP_ROLLBACK_ENABLE=y
# The LVGL fork in firmware/components' manifests ships without demos and examples
# CONFIG_LV_BUILD_EXAMPLES is not set
# CONFIG_LV_BUILD_DEMOS is not set

# orb_net, as listed in ../README.md ("Required sdkconfig")
# Bluetooth LE, only for Wi-Fi provisioning
CONFIG_BT_ENABLED=y
CONFIG_BT_NIMBLE_ENABLED=y
CONFIG_ESP_PROTOCOMM_SUPPORT_SECURITY_VERSION_1=y
# CONFIG_ESP_PROTOCOMM_SUPPORT_SECURITY_VERSION_2 is not set
# Internal RAM: Bluetooth
CONFIG_BT_CTRL_RUN_IN_FLASH_ONLY=y
CONFIG_BT_NIMBLE_MEM_ALLOC_MODE_EXTERNAL=y
# CONFIG_BT_NIMBLE_ROLE_CENTRAL is not set
# CONFIG_BT_NIMBLE_ROLE_OBSERVER is not set
CONFIG_BT_NIMBLE_MAX_CONNECTIONS=1
# Internal RAM: Wi-Fi, lwIP, mbedTLS (Espressif's "memory saving" rank for S3 with PSRAM)
CONFIG_SPIRAM_TRY_ALLOCATE_WIFI_LWIP=y
CONFIG_MBEDTLS_EXTERNAL_MEM_ALLOC=y
# CONFIG_ESP_WIFI_IRAM_OPT is not set
# CONFIG_ESP_WIFI_RX_IRAM_OPT is not set
CONFIG_ESP_WIFI_STATIC_RX_BUFFER_NUM=6
CONFIG_ESP_WIFI_STATIC_TX_BUFFER_NUM=6
CONFIG_ESP_WIFI_RX_BA_WIN=12
# CONFIG_ESP_WIFI_SOFTAP_SUPPORT is not set
# CONFIG_ESP_WIFI_ENTERPRISE_SUPPORT is not set
# Internal RAM: mDNS
CONFIG_MDNS_MEMORY_ALLOC_SPIRAM=y
CONFIG_MDNS_TASK_CREATE_FROM_SPIRAM=y
# CONFIG_MDNS_ENABLE_CONSOLE_CLI is not set
# CONFIG_MDNS_ENABLE_BROWSE is not set
# CONFIG_MDNS_PREDEF_NETIF_AP is not set
```

## firmware/components/orb_shell/Kconfig
```kconfig
menu "Orb shell"

config ORB_OPEN_LATENCY_FIXES
    bool "Preload and stage app opening (disable only for latency A/B control)"
    default y
    help
        Prepare Default fonts before Wi-Fi, present navigation chrome before
        destination construction, slice app/list construction across refreshes,
        and retain at most two PSRAM launch snapshots. Disable only for a
        same-source bench_open control with lazy fonts and full-page construction.
        Navigation accounting remains available in both cases.

endmenu
```

## firmware/components/orb_ui/Kconfig
```kconfig
menu "Orb presentation"

config ORB_UI_SCROLL_EDGE_SOFT
    bool "Consistent soft scroll edges under navigation and toward the bezel"
    default y
    help
        Dissolve exiting list/prose content into the black canvas, with no
        top fade on the first resting row. Keep navigation outside the content
        viewport so glass samples black throughout a fling. Disable for the
        previous surface-specific fade distances in a same-source A/B.

endmenu
```

## firmware/main/Kconfig.projbuild
```kconfig
menu "Orb runtime"

    config ORB_NETWORK_BSS_PSRAM
        bool "Place IDF network-library BSS in PSRAM"
        depends on SPIRAM
        select SPIRAM_ALLOW_BSS_SEG_EXTERNAL_MEMORY
        default n
        help
            Use IDF's linker fragments for external Wi-Fi/lwIP/Bluetooth BSS.
            Independent of generic malloc placement; moves linked static state,
            not DMA buffers or task stacks. Exact recovery requires the ELF map.
            Keep off until reconnect, provisioning and concurrent OTA/rendering
            have been measured, since this changes radio/cache access patterns.

    config ORB_SMALL_ALLOCATIONS_PSRAM
        bool "Prefer PSRAM even for small generic heap allocations"
        depends on SPIRAM_USE_MALLOC
        default n
        help
            Set the generic malloc/realloc internal-preference threshold to zero
            before LVGL and network startup. The normal threshold is 1024 bytes.
            Moves small widget/style/draw metadata and other generic allocations
            toward PSRAM, with IDF's normal fallback on exhaustion. Explicit
            internal/DMA allocations and FreeRTOS stacks/queues stay internal.
            May trade CPU/cache performance for contiguous internal RAM; compare
            this alone before trying the second display buffer. Default off
            until provisioning, TLS reconnect and OTA are verified on hardware.

    config ORB_DYNAMIC_FREQUENCY_SCALING
        bool "Allow the idle CPU to scale to 80 MHz"
        depends on PM_ENABLE
        default n
        help
            Experimental: run at 240 MHz while tasks are active and allow
            80 MHz when both cores are idle. Light sleep is separately gated
            by ORB_LIGHT_SLEEP and runtime eligibility. Requires
            CONFIG_PM_ENABLE. Keep disabled until board timing, networking
            and power measurements validate the change. Developer command
            power reports cumulative mode residency when PM_PROFILING is on.

    config ORB_LIGHT_SLEEP
        bool "Allow automatic light sleep in battery Sleep"
        depends on PM_ENABLE && FREERTOS_USE_TICKLESS_IDLE
        select PM_LIGHT_SLEEP_CALLBACKS
        default y
        help
            Keep a NO_LIGHT_SLEEP lock except during confirmed panel-off Sleep
            on battery with no active work. GPIO touch/buttons, Wi-Fi and IDF's
            timer wake must all be armed successfully. USB stays awake unless
            the RAM-only developer override is explicitly enabled.

    config ORB_GLASS_BACKDROP_CACHE
        bool "Cache reusable glass backdrops"
        default n
        help
            Experimental renderer cache; buffers must use PSRAM. Keep disabled
            until pixel equivalence, scene invalidation, memory use and device
            frame timing have been checked. Independent of CPU frequency scaling.

endmenu
```
